/*@!Encoding:1252*/
/*===========================================================================
  NetworkLayer_API.cin

  SBCM ECU Simulator - Network Layer (ISO 15765-2 / ISO-TP)
  --------------------------------------------------------------------------
  Database: SBCM_XX_CANFD_DataBase_v0_1.dbc
      SBCM_Diag_Req  (0x7B0, 1968) : Tester(OBD) -> SBCM  (Request / FlowControl)
      SBCM_Diag_Resp (0x7B8, 1976) : SBCM -> Tester(OBD)  (Response / FlowControl)

  NOTE ON THE DBC:
      In DBC v0.1 the transmitter nodes of the two messages are swapped.
      (SBCM_Diag_Req is declared with Tx = SBCM, SBCM_Diag_Resp with Tx = OBD)
      This does not affect the "on message" trigger behaviour, but it does not
      match the usual UDS physical addressing convention (Tester->ECU / ECU->
      Tester). Fixing the DBC is recommended.
      This module is implemented according to the intended behaviour:
      SBCM receives on 0x7B0 and responds on 0x7B8.

  SCOPE:
      This module implements ONLY the ISO-TP segmentation and reassembly on
      top of Classic CAN 8 byte frames. UDS service handling (0x10, 0x22,
      0x19, ...) belongs to the Application Layer.

      The Network Layer connects to the Application Layer through exactly
      two interfaces:

      [RX] Called by the Network Layer once a request has been reassembled:
              void AppLayer_OnDiagRequestReceived(byte data[], word len)
           -> MUST be implemented by the Application Layer (main .can file).

      [TX] Called by the Application Layer to send a response:
              void NetworkLayer_SendResponse(byte data[], word len)

      [INIT] MUST be called from the Application Layer "on preStart":
              void NetworkLayer_Init()

  ENCODING:
      This file is intentionally pure ASCII (no localized characters) so that
      it is immune to code page issues between CANoe, Git and text editors.
===========================================================================*/

includes
{
}

variables
{
    // ---- Message object based on DBC symbols ----
    // (RX frames are accessed via "this" inside on message, so only the TX
    //  message object needs to be declared here.)
    message SBCM_Diag_Resp respMsg;

    // ---- ISO-TP PCI types ----
    enum NL_PCI_TYPE
    {
        NL_PCI_SF = 0,  // Single Frame
        NL_PCI_FF,      // First Frame
        NL_PCI_CF,      // Consecutive Frame
        NL_PCI_FC       // Flow Control
    };

    // ---- Flow Control - FlowStatus values ----
    const byte FC_FS_CTS   = 0x00;  // Continue To Send
    const byte FC_FS_WAIT  = 0x01;  // Wait
    const byte FC_FS_OVFLW = 0x02;  // Overflow / Abort

    // ---- Classic CAN 8 byte ISO-TP constants ----
    const byte  CLASSIC_CAN_DLC = 8;
    const byte  SF_MAX_DATA     = 7;    // max payload in a Single Frame
    const byte  FF_FIRST_DATA   = 6;    // payload carried by a First Frame
    const byte  CF_MAX_DATA     = 7;    // payload per Consecutive Frame
    const word  ISOTP_MAX_LEN   = 4095; // max length for classic ISO-TP
    const byte  PADDING_BYTE    = 0x55; // padding value (adjust per OEM spec)

    // ---- Flow Control parameters sent by SBCM while receiving a request ----
    // BlockSize = 0 : receive all remaining frames without further FC
    // STmin     = 0 : no minimum separation time required
    const byte  OWN_BLOCK_SIZE = 0;
    const byte  OWN_ST_MIN     = 0x00;

    // ---- Timeouts (ISO-TP parameter names: N_Bs, N_Cr) ----
    const dword N_BS_TIMEOUT_MS = 1000; // waiting for FC while transmitting
    const dword N_CR_TIMEOUT_MS = 1000; // waiting for next CF while receiving

    // =======================================================================
    // RX state machine : reassembles requests (Tester -> SBCM, 0x7B0)
    // =======================================================================
    enum NL_RX_STATE_TYPE
    {
        NL_RX_IDLE,
        NL_RX_WAIT_CF
    } rxState;

    byte  rxBuffer[ISOTP_MAX_LEN];
    word  rxTotalLen;
    word  rxRecvLen;
    byte  rxExpectedSN;
    msTimer rxCrTimer;

    // =======================================================================
    // TX state machine : transmits responses (SBCM -> Tester, 0x7B8)
    // =======================================================================
    enum NL_TX_STATE_TYPE
    {
        NL_TX_IDLE,
        NL_TX_WAIT_FC,
        NL_TX_SENDING_CF
    } txState;

    byte  txBuffer[ISOTP_MAX_LEN];
    word  txTotalLen;
    word  txSentLen;
    byte  txSN;
    byte  txBlockSize;
    byte  txSTmin;
    byte  txFramesSinceFC;
    msTimer txBsTimer;
    msTimer txStminTimer;
}

// ===========================================================================
// Application Layer callback
// -> The body of this function must be implemented in the main .can file
//    that includes this module. Without it, compilation will fail.
// ===========================================================================


// ===========================================================================
// Public API : initialization
// ===========================================================================
void NetworkLayer_Init()
{
    rxState    = NL_RX_IDLE;
    txState    = NL_TX_IDLE;
    rxRecvLen  = 0;
    rxTotalLen = 0;
    txSentLen  = 0;
    txTotalLen = 0;

    cancelTimer(rxCrTimer);
    cancelTimer(txBsTimer);
    cancelTimer(txStminTimer);
}


// ===========================================================================
// RX path : reception of SBCM_Diag_Req (0x7B0)
//   SF/FF/CF : diagnostic request data sent by the tester
//   FC       : flow control for a multi frame response currently being sent
// ===========================================================================
on message SBCM_Diag_Req
{
    byte rxFrame[8];
    byte i;
    byte pciType;

    for (i = 0; i < 8; i++)
    {
        rxFrame[i] = this.byte(i);
    }

    pciType = (rxFrame[0] & 0xF0) >> 4;

    switch (pciType)
    {
        case NL_PCI_SF:
            NL_HandleSingleFrame(rxFrame);
            break;

        case NL_PCI_FF:
            NL_HandleFirstFrame(rxFrame);
            break;

        case NL_PCI_CF:
            NL_HandleConsecutiveFrame(rxFrame);
            break;

        case NL_PCI_FC:
            NL_HandleFlowControl(rxFrame);
            break;

        default:
            write("NetworkLayer(RX): Unknown PCI type (0x%X)", pciType);
            break;
    }
}

void NL_HandleSingleFrame(byte frame[])
{
    byte len;
    byte i;

    len = frame[0] & 0x0F;

    if (len == 0 || len > SF_MAX_DATA)
    {
        write("NetworkLayer(RX): Invalid SF length (%d)", len);
        return;
    }

    // A new SF discards any reassembly that is currently in progress.
    if (rxState != NL_RX_IDLE)
    {
        write("NetworkLayer(RX): SF received while reassembling - aborting previous reception");
    }
    NL_AbortReception();

    for (i = 0; i < len; i++)
    {
        rxBuffer[i] = frame[i + 1];
    }
    rxRecvLen = len;

    NL_IndicateRequestReceived();
}

void NL_HandleFirstFrame(byte frame[])
{
    word len;
    byte i;

    len = ((word)(frame[0] & 0x0F) << 8) | frame[1];

    if (len <= SF_MAX_DATA || len > ISOTP_MAX_LEN)
    {
        write("NetworkLayer(RX): Invalid FF length (%d)", len);
        return;
    }

    if (rxState != NL_RX_IDLE)
    {
        write("NetworkLayer(RX): FF received while reassembling - aborting previous reception");
    }

    rxTotalLen = len;
    rxRecvLen  = 0;

    for (i = 0; i < FF_FIRST_DATA; i++)
    {
        rxBuffer[rxRecvLen++] = frame[i + 2];
    }

    rxExpectedSN = 1;
    rxState      = NL_RX_WAIT_CF;

    // Immediately grant the tester permission to continue.
    NL_SendFlowControl(FC_FS_CTS, OWN_BLOCK_SIZE, OWN_ST_MIN);

    setTimer(rxCrTimer, N_CR_TIMEOUT_MS);
}

void NL_HandleConsecutiveFrame(byte frame[])
{
    byte sn;
    byte i;
    word remain;
    byte copyLen;

    if (rxState != NL_RX_WAIT_CF)
    {
        write("NetworkLayer(RX): Unexpected CF (no active reception) - ignored");
        return;
    }

    sn = frame[0] & 0x0F;

    if (sn != rxExpectedSN)
    {
        write("NetworkLayer(RX): SN mismatch. expected=%d received=%d", rxExpectedSN, sn);
        NL_AbortReception();
        return;
    }

    cancelTimer(rxCrTimer);

    remain  = rxTotalLen - rxRecvLen;
    copyLen = (remain < CF_MAX_DATA) ? (byte)remain : CF_MAX_DATA;

    for (i = 0; i < copyLen; i++)
    {
        rxBuffer[rxRecvLen++] = frame[i + 1];
    }

    // ISO 15765-2: SN wraps around 1->2->...->15->0->1... (modulo 16)
    rxExpectedSN = (rxExpectedSN + 1) & 0x0F;

    if (rxRecvLen >= rxTotalLen)
    {
        rxState = NL_RX_IDLE;
        NL_IndicateRequestReceived();
    }
    else
    {
        // Extension point: if OWN_BLOCK_SIZE > 0 is used, count the received
        // frames here and send another FC once BlockSize has been reached.
        // With OWN_BLOCK_SIZE = 0 (unlimited) no extra handling is required.
        setTimer(rxCrTimer, N_CR_TIMEOUT_MS);
    }
}

on timer rxCrTimer
{
    write("NetworkLayer(RX): N_Cr timeout - Consecutive Frame not received in time");
    NL_AbortReception();
}

void NL_AbortReception()
{
    rxState    = NL_RX_IDLE;
    rxRecvLen  = 0;
    rxTotalLen = 0;
    cancelTimer(rxCrTimer);
}

void NL_SendFlowControl(byte fs, byte bs, byte stmin)
{
    respMsg.dlc = CLASSIC_CAN_DLC;
    respMsg.byte(0) = (byte)((NL_PCI_FC << 4) | fs);
    respMsg.byte(1) = bs;
    respMsg.byte(2) = stmin;
    respMsg.byte(3) = PADDING_BYTE;
    respMsg.byte(4) = PADDING_BYTE;
    respMsg.byte(5) = PADDING_BYTE;
    respMsg.byte(6) = PADDING_BYTE;
    respMsg.byte(7) = PADDING_BYTE;

    output(respMsg);
}

void NL_IndicateRequestReceived()
{
    write("NetworkLayer(RX): UDS request reassembled (len=%d)", rxRecvLen);

    // Hand the complete UDS request over to the Application Layer.
    AppLayer_OnDiagRequestReceived(rxBuffer, rxRecvLen);
}


// ===========================================================================
// TX path : send an Application Layer response on SBCM_Diag_Resp (0x7B8)
// ===========================================================================
void NetworkLayer_SendResponse(byte data[], word len)
{
    byte i;

    if (len == 0 || len > ISOTP_MAX_LEN)
    {
        write("NetworkLayer(TX): Invalid response length (%d)", len);
        return;
    }

    if (txState != NL_TX_IDLE)
    {
        write("NetworkLayer(TX): Previous transmission still active - aborting it");
        NL_AbortTransmission();
    }

    for (i = 0; i < len; i++)
    {
        txBuffer[i] = data[i];
    }
    txTotalLen = len;
    txSentLen  = 0;

    if (len <= SF_MAX_DATA)
    {
        NL_SendSingleFrame();
    }
    else
    {
        NL_SendFirstFrame();
    }
}

void NL_SendSingleFrame()
{
    byte i;

    respMsg.dlc = CLASSIC_CAN_DLC;
    respMsg.byte(0) = (byte)((NL_PCI_SF << 4) | (txTotalLen & 0x0F));

    for (i = 0; i < txTotalLen; i++)
    {
        respMsg.byte(i + 1) = txBuffer[i];
    }
    for (i = (byte)txTotalLen; i < SF_MAX_DATA; i++)
    {
        respMsg.byte(i + 1) = PADDING_BYTE;
    }

    output(respMsg);

    write("NetworkLayer(TX): SF response sent (len=%d)", txTotalLen);

    txState   = NL_TX_IDLE;
    txSentLen = 0;
}

void NL_SendFirstFrame()
{
    byte i;

    respMsg.dlc = CLASSIC_CAN_DLC;
    respMsg.byte(0) = (byte)((NL_PCI_FF << 4) | ((txTotalLen >> 8) & 0x0F));
    respMsg.byte(1) = (byte)(txTotalLen & 0xFF);

    for (i = 0; i < FF_FIRST_DATA; i++)
    {
        respMsg.byte(i + 2) = txBuffer[i];
    }

    output(respMsg);

    txSentLen = FF_FIRST_DATA;
    txSN      = 1;
    txState   = NL_TX_WAIT_FC;

    setTimer(txBsTimer, N_BS_TIMEOUT_MS);
}

void NL_HandleFlowControl(byte frame[])
{
    byte fs;

    if (txState != NL_TX_WAIT_FC)
    {
        // FC received while no response transmission is pending - ignore.
        return;
    }

    fs = frame[0] & 0x0F;
    cancelTimer(txBsTimer);

    switch (fs)
    {
        case FC_FS_CTS:
            txBlockSize     = frame[1];
            txSTmin         = frame[2];
            txFramesSinceFC = 0;
            txState         = NL_TX_SENDING_CF;
            NL_SendOneConsecutiveFrame();
            break;

        case FC_FS_WAIT:
            setTimer(txBsTimer, N_BS_TIMEOUT_MS);  // keep waiting
            break;

        case FC_FS_OVFLW:
            write("NetworkLayer(TX): FlowControl Overflow received - aborting transmission");
            NL_AbortTransmission();
            break;

        default:
            write("NetworkLayer(TX): Unknown FlowStatus (0x%X) - aborting", fs);
            NL_AbortTransmission();
            break;
    }
}

void NL_SendOneConsecutiveFrame()
{
    byte i;
    word remain;
    byte copyLen;

    remain  = txTotalLen - txSentLen;
    copyLen = (remain < CF_MAX_DATA) ? (byte)remain : CF_MAX_DATA;

    respMsg.dlc = CLASSIC_CAN_DLC;
    respMsg.byte(0) = (byte)((NL_PCI_CF << 4) | (txSN & 0x0F));

    for (i = 0; i < copyLen; i++)
    {
        respMsg.byte(i + 1) = txBuffer[txSentLen + i];
    }
    for (i = copyLen; i < CF_MAX_DATA; i++)
    {
        respMsg.byte(i + 1) = PADDING_BYTE;
    }

    output(respMsg);

    txSentLen += copyLen;
    // ISO 15765-2: SN wraps around 1->2->...->15->0->1... (modulo 16)
    txSN = (txSN + 1) & 0x0F;
    txFramesSinceFC++;

    if (txSentLen >= txTotalLen)
    {
        write("NetworkLayer(TX): Multi frame response complete (len=%d)", txTotalLen);
        txState = NL_TX_IDLE;
        return;
    }

    if (txBlockSize != 0 && txFramesSinceFC >= txBlockSize)
    {
        // BlockSize reached - wait for the next FlowControl.
        txState = NL_TX_WAIT_FC;
        setTimer(txBsTimer, N_BS_TIMEOUT_MS);
        return;
    }

    // Respect STmin before sending the next CF.
    setTimer(txStminTimer, NL_ConvertSTmin(txSTmin));
}

on timer txStminTimer
{
    NL_SendOneConsecutiveFrame();
}

on timer txBsTimer
{
    write("NetworkLayer(TX): N_Bs timeout - FlowControl not received in time");
    NL_AbortTransmission();
}

void NL_AbortTransmission()
{
    txState    = NL_TX_IDLE;
    txSentLen  = 0;
    txTotalLen = 0;
    cancelTimer(txBsTimer);
    cancelTimer(txStminTimer);
}

// Convert the ISO-TP STmin encoding into a CAPL msTimer value (1 ms base).
//   0x00 - 0x7F :   0 - 127 ms
//   0xF1 - 0xF9 : 100 - 900 us  (rounded up to 1 ms, msTimer cannot do us)
//   others      : reserved
dword NL_ConvertSTmin(byte stmin)
{
    if (stmin <= 0x7F)
    {
        return stmin;
    }
    else if (stmin >= 0xF1 && stmin <= 0xF9)
    {
        return 1;
    }
    else
    {
        write("NetworkLayer(TX): Reserved STmin value (0x%X) - falling back to 127 ms", stmin);
        return 127;
    }
}
