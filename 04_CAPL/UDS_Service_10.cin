/*@!Encoding:1252*/
/*===========================================================================
  UDS_Service_10.cin

  DiagnosticSessionControl (0x10) service implementation.

  This module provides a simple UDS 0x10 handler suitable for the
  existing application layer structure.

  The Application Layer must:
      - #include "UDS_Service_10.cin"
      - call UDS_Service_10_Init() from on preStart
      - call Handle_DiagnosticSessionControl(data, len) from the UDS request dispatcher
===========================================================================*/
/*---------------------------------------------------------------------------
  Revision History
  Project: UDS Study
-----------------------------------------------------------------------------
  Date          Author                      Description
-----------------------------------------------------------------------------
  2026-07-28    lee.sungwon@slworld.com    Initial implementation - 0x10
                                            DiagnosticSessionControl
                                            (Default/Extended session switch)
  2026-08-10    lee.sungwon@slworld.com    Tightened the length check
                                            len<2 -> len!=2; added
                                            UDS_SetCurrentSession() (used by
                                            0x3E's S3 timer to revert the
                                            session)
  2026-08-16    lee.sungwon@slworld.com    Applied the ISO 14229-1 Figure 5/6
                                            NRC priority order
                                            (service-supported-in-session
                                            check -> length check ->
                                            sub-function-supported check ->
                                            sub-function-supported-in-session
                                            check)
  2026-08-18    lee.sungwon@slworld.com    Added Programming Session
                                            (subFunction 0x02, ES95486-02
                                            Table 4-2) support. Per
                                            ES95486-02 Table 3-1 footnote C2
                                            and Table 4-4 (NRC 0x22
                                            conditionNotCorrect), transitioning
                                            into the Programming Session
                                            requires "Engine stop, IGN on";
                                            this project is an EV, so the
                                            condition is VCU stop (
                                            VCU_EvDrvRdySta) AND IGN1 on (
                                            BCM_Ign1InSta) - see
                                            VehicleCondition.cin. This is the
                                            only sub-function transition
                                            among this simulator's services
                                            that ES95486-02 actually
                                            condition-gates (TesterPresent and
                                            ReadDataByIdentifier are "no
                                            restriction" per Table 3-1 / 4.5.3
                                            / 5.1.3 and are intentionally left
                                            unchanged). Only Programming
                                            Session entry (positive response)
                                            is added here; the actual
                                            reprogramming services (e.g.
                                            WriteDataByIdentifier,
                                            RequestDownload/TransferData/
                                            TransferExit) remain unimplemented
                                            and out of scope.
-----------------------------------------------------------------------------*/

variables
{
    const byte SID_DIAGNOSTIC_SESSION_CONTROL        = 0x10;

    const byte SUBFUNC_DEFAULT_SESSION               = 0x01;
    const byte SUBFUNC_PROGRAMMING_SESSION           = 0x02;
    const byte SUBFUNC_EXTENDED_DIAGNOSTIC_SESSION   = 0x03;

    byte currentSession;
}

void UDS_Service_10_Init()
{
    currentSession = SUBFUNC_DEFAULT_SESSION;
}

byte UDS_GetCurrentSession()
{
    return currentSession;
}

// Allows other service modules (e.g. UDS_Service_3E's S3 timer) to change
// the active session without reaching into this module's private state.
void UDS_SetCurrentSession(byte session)
{
    currentSession = session;
}

// NRC priority order per ISO 14229-1 Figure 5 / Figure 6 (see UDS_Common.cin
// for the full chain). "SID supported?" (NRC 0x11) is already handled by the
// caller's dispatch switch before this function is reached.
void Handle_DiagnosticSessionControl(byte data[], word len)
{
    byte subFunction;
    byte responseSid;
    byte resp[2];

    // Figure 5 step 2: SID supported in the active session?
    if (!UDS_IsServiceSupportedInSession())
    {
        AppLayer_SendNegativeResponse(SID_DIAGNOSTIC_SESSION_CONTROL,
                                      NRC_SERVICE_NOT_SUPPORTED_IN_SESSION);
        return;
    }

    // Figure 6 step 4: minimum length check
    if (len != 2)
    {
        AppLayer_SendNegativeResponse(SID_DIAGNOSTIC_SESSION_CONTROL,
                                      NRC_INCORRECT_MESSAGE_LENGTH_OR_FORMAT);
        return;
    }

    subFunction = data[1];

    // Figure 6 step 5: sub-function supported at all?
    if (subFunction != SUBFUNC_DEFAULT_SESSION
        && subFunction != SUBFUNC_PROGRAMMING_SESSION
        && subFunction != SUBFUNC_EXTENDED_DIAGNOSTIC_SESSION)
    {
        AppLayer_SendNegativeResponse(SID_DIAGNOSTIC_SESSION_CONTROL,
                                      NRC_SUBFUNCTION_NOT_SUPPORTED);
        return;
    }

    // Figure 6 step 6: sub-function supported in the active session?
    if (!UDS_IsSubFunctionSupportedInSession())
    {
        AppLayer_SendNegativeResponse(SID_DIAGNOSTIC_SESSION_CONTROL,
                                      NRC_SUBFUNCTION_NOT_SUPPORTED_IN_SESSION);
        return;
    }

    // Figure 6 step 7 / ES95486-02 Table 3-1 footnote C2: entering the
    // Programming Session requires "Engine stop, IGN on" (VCU stop AND
    // IGN1 on for this EV project). This is checked here, as part of the
    // "specific SID checks" step, and only for this one sub-function -
    // Default/Extended session requests have "no restriction" per
    // ES95486-02 Table 3-1.
    if (subFunction == SUBFUNC_PROGRAMMING_SESSION && !UDS_IsEngineConditionOk())
    {
        AppLayer_SendNegativeResponse(SID_DIAGNOSTIC_SESSION_CONTROL,
                                      NRC_CONDITIONS_NOT_CORRECT);
        return;
    }

    // Figure 6 step 7: execute service
    currentSession = subFunction;
    responseSid = (byte)(SID_DIAGNOSTIC_SESSION_CONTROL + SID_POSITIVE_RESPONSE_OFFSET);
    resp[0] = responseSid;
    resp[1] = subFunction;
    write("UDS_Service_10: DiagnosticSessionControl positive response sent (subFunction=0x%02X)", subFunction);
    NetworkLayer_SendResponse(resp, 2);
}
