/*@!Encoding:1252*/
/*===========================================================================
  UDS_Service_31.cin

  RoutineControl (0x31) UDS service implementation, per ES95486-02 8.1
  (Table 8-1 ~ 8-5) and 8.1.4.8 (CheckProgrammingDependancy).

  Only the ES95486-02 10.2 reprogramming sequence's two routines are
  implemented (8.1: "Reprogram routine (eraseMemory,
  checkProgrammingDependencies) has to be secured by respective ECU
  security option"):
      routineIdentifier 0xFF00  eraseMemory (Calibration Data & Program)
      routineIdentifier 0xFF01  checkProgrammingDependencies
  Any other routineIdentifier (including the OTA/FoD-specific ranges in
  Table 8-3, which this simulator does not implement) -> NRC 0x31.

  Only the startRoutine (0x01) sub-function is implemented; stopRoutine
  (0x02) and requestRoutineResults (0x03) are Cvt=U (optional, Table 8-2)
  and are not needed for either routine in this simulator - both
  routines complete synchronously within the startRoutine call itself
  (there is no real flash memory to erase, and no real checksum to
  verify, so "start" and "finish" happen in the same request/response
  cycle) -> requesting 0x02/0x03 gets NRC 0x12 (subFunctionNotSupported).

  checkProgrammingDependencies (0xFF01) still has no routineControlOptionRecord
  - only the bare 4-byte request/response shown in ES95486-02's own worked
  example is accepted:
      Request:  31 01 FF 01
      Response: 71 01 FF 01

  eraseMemory (0xFF00), as of 2026-08-19, DOES implement a
  routineControlOptionRecord / routineStatusRecord - this project's
  real-world reference spec (NE1aW_SBCM_Diagnostic_Data_251104.xlsx, "RID
  FF00" sheet) documents a concrete SWUnitMemoryArea parameter for this
  exact routine (not left abstract like ES95486-02 Table 8-47's generic
  MemoryArea):
      Request:  31 01 FF 00 <SWUnitMemoryArea 2 byte>            (6 bytes)
      Response: 71 01 FF 00 <SWUnitMemoryArea 2 byte><ErasedPartitionArea 1 byte> (7 bytes)
  This simulator echoes the requested SWUnitMemoryArea back unchanged as
  Out_SWUnitMemoryArea, and always reports ErasedPartitionArea=0x01
  (success) - there is no real flash memory or partition table to erase,
  so this is a fixed simulated-success value, documented as an intentional
  simplification (same spirit as checkProgrammingDependencies always
  succeeding, below).

  IMPORTANT session/security design note: ES95486-02 Table 3-1 marks
  RoutineControl (31 hex) with the Circle symbol ("Specific sub-function
  possible in the selected diag. Mode (see each function descriptions)")
  in EVERY session, including the Default Session - unlike every other
  gated service in this project (0x27/0x28/0x2E/0x2F/0x85), which are
  marked X (impossible) in specific sessions and are blocked with an
  explicit up-front session check. RoutineControl's gating is instead
  delegated entirely to "each function description" - for eraseMemory
  and checkProgrammingDependencies, that description (8.1, quoted above)
  is purely a security requirement, not a session requirement. This file
  therefore does NOT block the Default Session up front; instead it
  relies on the SecurityAccess-unlocked check below, which is
  necessarily false in the Default Session anyway (SecurityAccess itself
  is X/blocked there - UDS_Service_27.cin), and so a Default-Session
  request naturally and correctly receives NRC 0x33
  (securityAccessDenied) rather than NRC 0x7F.

  The Application Layer must:
      - #include "UDS_Service_31.cin"
      - call Handle_RoutineControl(data, len) from the UDS request
        dispatcher (no _Init() needed - this module holds no persistent
        state of its own; eraseMemory resets UDS_Service_34_35_36_37.cin's
        transfer-session state via TransferSession_Reset())
===========================================================================*/
/*---------------------------------------------------------------------------
  Revision History
  Project: UDS Study
-----------------------------------------------------------------------------
  Date          Author                      Description
-----------------------------------------------------------------------------
  2026-08-18    lee.sungwon@slworld.com    Initial implementation - 0x31
                                            RoutineControl, startRoutine
                                            only, routineIdentifier
                                            0xFF00 (eraseMemory) and
                                            0xFF01 (checkProgramming
                                            Dependencies), per ES95486-02
                                            8.1 / 8.1.4.8 and the Table
                                            10-11 worked example. Stage 3
                                            of the ES95486-02 10.2
                                            reprogramming sequence
                                            implementation (see also
                                            UDS_Service_34_35_36_37.cin).
  2026-08-19    lee.sungwon@slworld.com    eraseMemory (0xFF00) now
                                            implements a real
                                            routineControlOptionRecord
                                            (SWUnitMemoryArea, 2 byte
                                            request) / routineStatusRecord
                                            (SWUnitMemoryArea +
                                            ErasedPartitionArea, 3 byte
                                            response), per this project's
                                            real-world reference spec's
                                            "RID FF00" sheet.
                                            checkProgrammingDependencies
                                            (0xFF01) is unchanged (still
                                            the bare ES95486-02 Table 10-11
                                            worked-example format).
-----------------------------------------------------------------------------*/

variables
{
    const byte SID_ROUTINE_CONTROL = 0x31;

    const byte RC_START_ROUTINE = 0x01;
    // stopRoutine (0x02) / requestRoutineResults (0x03) are recognized as
    // valid sub-function VALUES (so an unrecognized value still correctly
    // gets NRC 0x12, not NRC 0x31) but are not supported by either routine
    // this simulator implements - see file header.
    const byte RC_STOP_ROUTINE            = 0x02;
    const byte RC_REQUEST_ROUTINE_RESULTS = 0x03;

    const word RID_ERASE_MEMORY                   = 0xFF00;
    const word RID_CHECK_PROGRAMMING_DEPENDENCIES = 0xFF01;

    // Minimum/checkProgrammingDependencies request+response length:
    // SID + routineControlType + routineIdentifier(2) = 4 bytes (no
    // routineControlOptionRecord/routineStatusRecord for this routine).
    const byte RC_REQ_LEN = 4;

    // eraseMemory (0xFF00)-specific lengths, per the reference spec's "RID
    // FF00" sheet: request adds a 2-byte SWUnitMemoryArea
    // routineControlOptionRecord; response adds a 3-byte routineStatusRecord
    // (SWUnitMemoryArea echo + 1-byte ErasedPartitionArea).
    const byte RC_ERASE_REQ_LEN  = RC_REQ_LEN + 2; // 6
    const byte RC_ERASE_RESP_LEN = RC_REQ_LEN + 3; // 7
    const byte ERASED_PARTITION_AREA_OK = 0x01;    // fixed simulated-success value
}

// NRC priority order per ISO 14229-1 Figure 5 (see UDS_Common.cin for the
// full chain) / Figure 8-1 (Key 1: "at least 4 (SI+SubFunction+RID
// Parameter)"). Unlike this simulator's other session-gated services, no
// up-front session block is applied here - see the file header's
// "IMPORTANT session/security design note".
void Handle_RoutineControl(byte data[], word len)
{
    byte routineControlType;
    word rid;
    byte responseSid;
    byte resp[7]; // sized for RID_ERASE_MEMORY's longer response (RC_ERASE_RESP_LEN)
    byte respLen;
    word swUnitMemoryArea;

    // Figure 8-1 Key 1: minimum length check (need at least SID +
    // routineControlType + routineIdentifier to identify the request).
    if (len < RC_REQ_LEN)
    {
        AppLayer_SendNegativeResponse(SID_ROUTINE_CONTROL,
                                      NRC_INCORRECT_MESSAGE_LENGTH_OR_FORMAT);
        return;
    }

    routineControlType = data[1];

    // Sub-function supported at all? (Table 8-2 defines 01/02/03; this
    // simulator implements only startRoutine - see file header.)
    if (routineControlType != RC_START_ROUTINE
        && routineControlType != RC_STOP_ROUTINE
        && routineControlType != RC_REQUEST_ROUTINE_RESULTS)
    {
        AppLayer_SendNegativeResponse(SID_ROUTINE_CONTROL,
                                      NRC_SUBFUNCTION_NOT_SUPPORTED);
        return;
    }
    if (routineControlType != RC_START_ROUTINE)
    {
        write("UDS_Service_31: stopRoutine/requestRoutineResults not supported "
              "(routineControlType=0x%02X) - both implemented routines complete "
              "synchronously within startRoutine", routineControlType);
        AppLayer_SendNegativeResponse(SID_ROUTINE_CONTROL,
                                      NRC_SUBFUNCTION_NOT_SUPPORTED);
        return;
    }

    rid = ((word)data[2] << 8) | data[3];

    // Table 8-5, NRC 0x31 cause #1: "The server does not supported the
    // requested routineIdentifier."
    if (rid != RID_ERASE_MEMORY && rid != RID_CHECK_PROGRAMMING_DEPENDENCIES)
    {
        write("UDS_Service_31: Unsupported routineIdentifier (0x%04X)", rid);
        AppLayer_SendNegativeResponse(SID_ROUTINE_CONTROL,
                                      NRC_REQUEST_OUT_OF_RANGE);
        return;
    }

    // Exact length check: RID-dependent since 2026-08-19 - eraseMemory now
    // requires a 2-byte SWUnitMemoryArea routineControlOptionRecord (real
    // reference spec, "RID FF00" sheet), while checkProgrammingDependencies
    // still takes no parameters at all (see file header).
    if (rid == RID_ERASE_MEMORY)
    {
        if (len != RC_ERASE_REQ_LEN)
        {
            AppLayer_SendNegativeResponse(SID_ROUTINE_CONTROL,
                                          NRC_INCORRECT_MESSAGE_LENGTH_OR_FORMAT);
            return;
        }
    }
    else // RID_CHECK_PROGRAMMING_DEPENDENCIES
    {
        if (len != RC_REQ_LEN)
        {
            AppLayer_SendNegativeResponse(SID_ROUTINE_CONTROL,
                                          NRC_INCORRECT_MESSAGE_LENGTH_OR_FORMAT);
            return;
        }
    }

    // ES95486-02 8.1: both routines "have to be secured by respective ECU
    // security option". See file header for why this is the ONLY gating
    // check here (no up-front session block).
    if (!SecurityAccess_IsUnlocked())
    {
        AppLayer_SendNegativeResponse(SID_ROUTINE_CONTROL,
                                      NRC_SECURITY_ACCESS_DENIED);
        return;
    }

    responseSid = (byte)(SID_ROUTINE_CONTROL + SID_POSITIVE_RESPONSE_OFFSET);
    resp[0] = responseSid;
    resp[1] = routineControlType;
    resp[2] = data[2];
    resp[3] = data[3];

    // ---- Execute ----
    if (rid == RID_ERASE_MEMORY)
    {
        // No real flash memory exists in this simulator; "erasing" it is
        // modeled as clearing any prior/in-progress transfer session, so a
        // fresh RequestDownload can start cleanly afterwards - matching the
        // real sequence (Table 10-2: eraseMemory always precedes the first
        // RequestDownload of the application software).
        TransferSession_Reset();

        // routineStatusRecord: Out_SWUnitMemoryArea echoes the requested
        // In_SWUnitMemoryArea unchanged; Out_ErasedPartitionArea is a fixed
        // simulated-success value (see file header - no real partition
        // table exists to report on).
        swUnitMemoryArea = ((word)data[4] << 8) | data[5];
        resp[4] = data[4];
        resp[5] = data[5];
        resp[6] = ERASED_PARTITION_AREA_OK;
        respLen = RC_ERASE_RESP_LEN;

        write("UDS_Service_31: eraseMemory (0xFF00) - simulated, transfer session reset "
              "(SWUnitMemoryArea=0x%04X, ErasedPartitionArea=0x%02X)",
              swUnitMemoryArea, ERASED_PARTITION_AREA_OK);
    }
    else // RID_CHECK_PROGRAMMING_DEPENDENCIES
    {
        // No real integrity/checksum check is possible without real flash
        // content; this simulator always reports success. A real ECU would
        // verify the downloaded software here and could fail with NRC 0x72
        // (generalProgrammingFailure) - documented as an intentional
        // simplification for a study project.
        respLen = RC_REQ_LEN;
        write("UDS_Service_31: checkProgrammingDependencies (0xFF01) - simulated, always succeeds");
    }

    write("UDS_Service_31: RoutineControl positive response sent (RID=0x%04X, len=%d)", rid, respLen);
    NetworkLayer_SendResponse(resp, respLen);
}
