/*@!Encoding:1252*/
/*===========================================================================
  SBCM_ECU_Simulator.can

  SBCM ECU Simulator - Main Node (Application Layer)
  --------------------------------------------------------------------------
  This file demonstrates how to use NetworkLayer_API.cin.

  At this stage the Application Layer is only a skeleton: every incoming
  request is answered with a negative response, NRC 0x11 (serviceNotSupported).

  Next step: implement the actual UDS services inside
  AppLayer_OnDiagRequestReceived(), e.g.
      0x10 DiagnosticSessionControl
      0x22 ReadDataByIdentifier
      0x19 ReadDTCInformation

  ENCODING:
      This file is intentionally pure ASCII (no localized characters) so that
      it is immune to code page issues between CANoe, Git and text editors.
===========================================================================*/

includes
{
    #include "NetworkLayer_API.cin"
}

variables
{
    // ---- Negative Response Codes (subset) ----
    const byte NRC_SERVICE_NOT_SUPPORTED = 0x11;

    const byte SID_NEGATIVE_RESPONSE = 0x7F;
}

on preStart
{
    NetworkLayer_Init();
    write("SBCM ECU Simulator: Network Layer initialized. Waiting for requests on 0x7B0 ...");
}

// ===========================================================================
// Application Layer callback
// Called by NetworkLayer_API.cin once a complete UDS request is available.
// ===========================================================================
void AppLayer_OnDiagRequestReceived(byte data[], word len)
{
    byte sid;

    sid = data[0];

    write("AppLayer: UDS request received (len=%d, SID=0x%02X)", len, sid);

    // TODO: replace with the real service dispatcher, for example
    //   switch (sid)
    //   {
    //       case 0x10: Handle_DiagnosticSessionControl(data, len); break;
    //       case 0x22: Handle_ReadDataByIdentifier(data, len);     break;
    //       case 0x19: Handle_ReadDTCInformation(data, len);       break;
    //       ...
    //   }

    AppLayer_SendNegativeResponse(sid, NRC_SERVICE_NOT_SUPPORTED);
}

// ===========================================================================
// Helper: send a negative response  ( 0x7F <SID> <NRC> )
// ===========================================================================
void AppLayer_SendNegativeResponse(byte sid, byte nrc)
{
    byte resp[3];

    resp[0] = SID_NEGATIVE_RESPONSE;
    resp[1] = sid;
    resp[2] = nrc;

    write("AppLayer: Negative response 0x7F 0x%02X 0x%02X", sid, nrc);

    NetworkLayer_SendResponse(resp, 3);
}
