/*@!Encoding:1252*/
/*===========================================================================
  SBCM_ECU_Simulator.can

  SBCM ECU Simulator - Main Node (Application Layer)
  --------------------------------------------------------------------------
  This file demonstrates how to use the Network Layer and UDS service modules.

  The Application Layer implements a simple request dispatcher that forwards
  supported service IDs to dedicated UDS service handlers.

  ENCODING:
      This file is intentionally pure ASCII (no localized characters) so that
      it is immune to code page issues between CANoe, Git and text editors.
===========================================================================*/
/*---------------------------------------------------------------------------
  Revision History
  Project: UDS Study
-----------------------------------------------------------------------------
  Date          Author                      Description
-----------------------------------------------------------------------------
  2026-07-28    lee.sungwon@slworld.com    Initial implementation - Network
                                            Layer / Application Layer
                                            integration structure, SID
                                            dispatcher
                                            (AppLayer_OnDiagRequestReceived),
                                            0x10/0x3E service wiring
  2026-07-30    lee.sungwon@slworld.com    Wired up the new 0x22
                                            ReadDataByIdentifier service
                                            (dispatcher case, UDS_SessionInit
                                            call)
  2026-08-10    lee.sungwon@slworld.com    Added the missing NetworkLayer_Init()
                                            call in on preStart (documented as
                                            mandatory but never actually
                                            invoked - fixed)
-----------------------------------------------------------------------------*/

includes
{
    #include "UDS_Common.cin"
    #include "NetworkLayer_API.cin"
    #include "UDS_Service_10.cin"
    #include "UDS_Service_3E.cin"
    #include "UDS_Service_22.cin"
}

variables
{
}

on preStart
{
    NetworkLayer_Init();
    UDS_SessionInit();
    write("SBCM ECU Simulator: UDS services initialized. Waiting for requests on 0x7B0 ...");
}

// ===========================================================================
// Application Layer callback
// Called by NetworkLayer_API.cin once a complete UDS request is available.
// ===========================================================================
void AppLayer_OnDiagRequestReceived(byte data[], word len)
{
    byte sid;

    sid = data[0];

    write("AppLayer: UDS request received (len=%d, SID=0x%02X)", len, sid);

    switch (sid)
    {
        case 0x10:
            UDS_Handle_DiagnosticSessionControl(data, len);
            break;

        case 0x3E:
            UDS_Handle_TesterPresent(data, len);
            break;

        case 0x22:
            UDS_Handle_ReadDataByIdentifier(data, len);
            break;

        default:
            AppLayer_SendNegativeResponse(sid, NRC_SERVICE_NOT_SUPPORTED);
            break;
    }
}

void UDS_SessionInit()
{
    UDS_Service_10_Init();
    UDS_Service_3E_Init();
    UDS_Service_22_Init();
}

void UDS_Handle_DiagnosticSessionControl(byte data[], word len)
{
    Handle_DiagnosticSessionControl(data, len);
}

void UDS_Handle_TesterPresent(byte data[], word len)
{
    Handle_TesterPresent(data, len);
}

void UDS_Handle_ReadDataByIdentifier(byte data[], word len)
{
    Handle_ReadDataByIdentifier(data, len);
}

// ===========================================================================
// Helper: send a negative response  ( 0x7F <SID> <NRC> )
// ===========================================================================
void AppLayer_SendNegativeResponse(byte sid, byte nrc)
{
    UDS_SendNegativeResponse(sid, nrc);
}
