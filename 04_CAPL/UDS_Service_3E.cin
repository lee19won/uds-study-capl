/*@!Encoding:1252*/
/*===========================================================================
  UDS_Service_3E.cin

  TesterPresent (0x3E) UDS service implementation.

  This module provides a lightweight TesterPresent handler compatible
  with the existing service-oriented application layer style.

  The Application Layer must:
      - #include "UDS_Service_3E.cin"
      - call UDS_Service_3E_Init() from on preStart
      - call Handle_TesterPresent(data, len) from the UDS request dispatcher
===========================================================================*/
/*---------------------------------------------------------------------------
  Revision History
  Project: UDS Study
-----------------------------------------------------------------------------
  Date          Author                      Description
-----------------------------------------------------------------------------
  2026-07-28    lee.sungwon@slworld.com    Initial implementation - 0x3E
                                            TesterPresent, S3 timer
                                            definition
  2026-08-10    lee.sungwon@slworld.com    Tightened the length check
                                            len<2 -> len!=2; S3 timer expiry
                                            now calls UDS_SetCurrentSession()
                                            to actually revert to the Default
                                            Session (previously only logged)
  2026-08-16    lee.sungwon@slworld.com    Applied the ISO 14229-1 Figure 5/6
                                            NRC priority order
  2026-08-18    lee.sungwon@slworld.com    Two fixes found on a re-read of
                                            ES95486-02: (1) TP_S3_TIMEOUT_MS
                                            was 3000 (3s), but Table 2-13
                                            defines S3Server as 5000ms
                                            (tolerance -0/+200ms) - corrected
                                            to 5000. (2) The S3 timer's
                                            revert-to-Default-Session handler
                                            now also calls
                                            SecurityAccess_ResetOnSessionChange()
                                            (UDS_Service_27.cin), since 4.1's
                                            transition rule 4 (non-default ->
                                            default) requires Security
                                            settings to be reset the same way
                                            an explicit DiagnosticSessionControl
                                            to defaultSession does - this
                                            applies whether the return to
                                            Default happens via an explicit
                                            0x10 request or via S3 timeout.
-----------------------------------------------------------------------------*/

variables
{
    const byte SID_TESTER_PRESENT                   = 0x3E;

    const byte SUBFUNC_KEEP_ALIVE                    = 0x00;
    const byte SUBFUNC_SUPPRESS_POSITIVE_RESPONSE    = 0x80;

    const dword TP_S3_TIMEOUT_MS                     = 5000; // ES95486-02 Table 2-13: S3Server, tolerance -0/+200ms

    msTimer tpS3Timer;
}

void UDS_Service_3E_Init()
{
    cancelTimer(tpS3Timer);
}

// NRC priority order per ISO 14229-1 Figure 5 / Figure 6 (see UDS_Common.cin
// for the full chain). "SID supported?" (NRC 0x11) is already handled by the
// caller's dispatch switch before this function is reached.
void Handle_TesterPresent(byte data[], word len)
{
    byte subFunction;
    byte suppressResponse;
    byte responseSid;
    byte resp[2];

    // Figure 5 step 2: SID supported in the active session?
    if (!UDS_IsServiceSupportedInSession())
    {
        AppLayer_SendNegativeResponse(SID_TESTER_PRESENT,
                                      NRC_SERVICE_NOT_SUPPORTED_IN_SESSION);
        return;
    }

    // Figure 6 step 4: minimum length check
    if (len != 2)
    {
        AppLayer_SendNegativeResponse(SID_TESTER_PRESENT,
                                      NRC_INCORRECT_MESSAGE_LENGTH_OR_FORMAT);
        return;
    }

    subFunction = data[1];
    suppressResponse = (subFunction & SUBFUNC_SUPPRESS_POSITIVE_RESPONSE) != 0;

    // Figure 6 step 5: sub-function supported at all?
    if ((subFunction & ~SUBFUNC_SUPPRESS_POSITIVE_RESPONSE) != SUBFUNC_KEEP_ALIVE)
    {
        AppLayer_SendNegativeResponse(SID_TESTER_PRESENT,
                                      NRC_SUBFUNCTION_NOT_SUPPORTED);
        return;
    }

    // Figure 6 step 6: sub-function supported in the active session?
    if (!UDS_IsSubFunctionSupportedInSession())
    {
        AppLayer_SendNegativeResponse(SID_TESTER_PRESENT,
                                      NRC_SUBFUNCTION_NOT_SUPPORTED_IN_SESSION);
        return;
    }

    // Figure 6 step 7: specific SID checks / execute service
    setTimer(tpS3Timer, TP_S3_TIMEOUT_MS);

    if (suppressResponse)
    {
        write("UDS_Service_3E: TesterPresent received with suppressed response");
        return;
    }

    responseSid = (byte)(SID_TESTER_PRESENT + SID_POSITIVE_RESPONSE_OFFSET);
    resp[0] = responseSid;
    resp[1] = SUBFUNC_KEEP_ALIVE;

    write("UDS_Service_3E: TesterPresent positive response sent (SID=0x%02X)", responseSid);
    NetworkLayer_SendResponse(resp, 2);
}

on timer tpS3Timer
{
    write("UDS_Service_3E: S3 timer expired - reverting to Default Session");
    UDS_SetCurrentSession(SUBFUNC_DEFAULT_SESSION);

    // ES95486-02 4.1, transition rule 4 (non-default -> default): Security
    // settings must be reset here too, not only on an explicit 0x10 request.
    SecurityAccess_ResetOnSessionChange();
}
